## configs/riscv64_defconfig
```kconfig
CONFIG_ISA_riscv64=y
CONFIG_CLINT_MMIO=0x42000000
CONFIG_CC_CLANG=y
CONFIG_CC_O3=y
CONFIG_CC_LTO=y
CONFIG_MSIZE=0x80000000
CONFIG_PC_RESET_OFFSET=0x0
# CONFIG_MEM_RANDOM is not set
# CONFIG_HAS_KEYBOARD is not set
# CONFIG_HAS_VGA is not set
# CONFIG_HAS_AUDIO is not set
# CONFIG_HAS_DISK is not set
CONFIG_SDCARD_CTL_MMIO=0x43000000
CONFIG_SDCARD_IMG_PATH="/home/yzh/projectn/debian-riscv64-swap.img"
# CONFIG_RT_CHECK is not set
CONFIG_TCACHE_SIZE=65536
CONFIG_BB_LIST_SIZE=8192
CONFIG_BB_POOL_SIZE=8192
```

## configs/x86-pa_defconfig
```kconfig
CONFIG_ISA_x86=y
CONFIG_PA=y
CONFIG_CC_CLANG=y
CONFIG_CC_O3=y
CONFIG_CC_LTO=y
CONFIG_MBASE=0x00000000
# CONFIG_RT_CHECK is not set
CONFIG_TCACHE_SIZE=65536
CONFIG_BB_LIST_SIZE=8192
CONFIG_BB_POOL_SIZE=8192
# CONFIG_BB_COUNT is not set
# CONFIG_EHELPER_COUNT is not set
```

## configs/x86-ref_defconfig
```kconfig
CONFIG_ISA_x86=y
CONFIG_x86_CC_SKIP=y
CONFIG_PA=y
CONFIG_TARGET_SHARE=y
CONFIG_CC_CLANG=y
CONFIG_CC_O3=y
CONFIG_CC_LTO=y
CONFIG_MBASE=0x00000000
# CONFIG_RT_CHECK is not set
# CONFIG_PERF_OPT is not set
```

## configs/x86-user-ref_defconfig
```kconfig
CONFIG_ISA_x86=y
CONFIG_x86_CC_SKIP=y
CONFIG_MODE_USER=y
CONFIG_TARGET_SHARE=y
CONFIG_CC_CLANG=y
CONFIG_CC_O3=y
CONFIG_CC_LTO=y
# CONFIG_RT_CHECK is not set
# CONFIG_BB_COUNT is not set
# CONFIG_EHELPER_COUNT is not set
```

## configs/x86-user_defconfig
```kconfig
CONFIG_ISA_x86=y
CONFIG_MODE_USER=y
CONFIG_CC_CLANG=y
CONFIG_CC_O3=y
CONFIG_CC_LTO=y
CONFIG_DIFFTEST=y
CONFIG_DIFFTEST_REF_NEMU=y
# CONFIG_RT_CHECK is not set
CONFIG_TCACHE_SIZE=65536
CONFIG_BB_LIST_SIZE=8192
CONFIG_BB_POOL_SIZE=8192
# CONFIG_BB_COUNT is not set
# CONFIG_EHELPER_COUNT is not set
```

## src/device/Kconfig
```kconfig
menuconfig DEVICE
  bool "Devices"
  default y
  help
    Provide device support for NEMU.

if DEVICE

config HAS_PORT_IO
  depends on !SHARE
  bool
  default y

menuconfig HAS_SERIAL
  depends on !SHARE
  bool "Enable serial"
  default y

menuconfig HAS_UARTLITE
  bool "Enable uartlite"
  default n

menuconfig HAS_UART_SNPS
  depends on !SHARE
  bool "Enable uart_snps"
  default n

menuconfig HAS_PLIC
  depends on !SHARE
  bool "Enable PLIC"
  default n

if HAS_SERIAL
config SERIAL_PORT
  depends on HAS_PORT_IO
  hex "Port address of the serial controller"
  default 0x3f8

config SERIAL_MMIO
  hex "MMIO address of the serial controller"
  default 0xa10003f8

config SERIAL_INPUT_FIFO
  bool "Enable input FIFO with /tmp/nemu.serial"
  default n

config SERIAL_UARTLITE
  bool "Use uartlite as the serial (default: 16550)"
  default n
endif # HAS_SERIAL

if HAS_UARTLITE
config UARTLITE_PORT
  depends on HAS_PORT_IO
  hex "Port address of uartlite controller"
  default 0x3f8

config UARTLITE_MMIO
  hex "MMIO address of uartlite controller"
  default 0xa10003f8

config UARTLITE_INPUT_FIFO
  bool "Enable input FIFO with /tmp/nemu.serial"
  default n
config UARTLITE_ASSERT_FOUR
  bool "Allow 4 byte write to allow community drivers"
endif # HAS_UARTLITE

if HAS_UART_SNPS
# config UARTLITE_PORT
#   depends on HAS_PORT_IO
#    hex "Port address of uartlite controller"
##   default 0x3f8

config UART_SNPS_MMIO
  hex "MMIO address of uartlite controller"
  default 0x310b0000

config UAR_SNPS_INPUT_FIFO
  bool "Enable input FIFO with /tmp/nemu.serial"
  default n
endif # HAS_UART_SNPS

if HAS_PLIC
config PLIC_ADDRESS
  hex "base address of PLIC"
  default 0x3c000000
endif

menuconfig HAS_TIMER
  depends on !SHARE
  bool "Enable timer"
  default y

if HAS_TIMER
config RTC_PORT
  depends on HAS_PORT_IO
  hex "Port address of the timer"
  default 0x48

config RTC_MMIO
  hex "MMIO address of the timer"
  default 0xa1000048
endif # HAS_TIMER

menuconfig HAS_KEYBOARD
  depends on !SHARE
  bool "Enable keyboard"
  default y

if HAS_KEYBOARD
config I8042_DATA_PORT
  depends on HAS_PORT_IO
  hex "Port address of the keyboard controller"
  default 0x60

config I8042_DATA_MMIO
  hex "MMIO address of the keyboard controller"
  default 0xa1000060
endif # HAS_KEYBOARD

menuconfig HAS_VGA
  bool "Enable VGA"
  default y

if HAS_VGA
config FB_ADDR
  hex "Physical address of the VGA frame buffer"
  default 0xa0000000

config VGA_CTL_PORT
  depends on HAS_PORT_IO
  hex "Port address of the VGA controller"
  default 0x100

config VGA_CTL_MMIO
  hex "MMIO address of the VGA controller"
  default 0xa1000100

config VGA_SHOW_SCREEN
  bool "Enable SDL SCREEN"
  default n

choice
  prompt "Screen Size"
  default VGA_SIZE_400x300
config VGA_SIZE_400x300
  bool "400 x 300"
config VGA_SIZE_800x600
  bool "800 x 600"
endchoice
endif # HAS_VGA

menuconfig HAS_AUDIO
  depends on !SHARE
  bool "Enable audio"
  default y

if HAS_AUDIO
config SB_ADDR
  hex "Physical address of the audio stream buffer"
  default 0xa0800000

config SB_SIZE
  hex "Size of the audio stream buffer"
  default 0x10000

config AUDIO_CTL_PORT
  depends on HAS_PORT_IO
  hex "Port address of the audio controller"
  default 0x200

config AUDIO_CTL_MMIO
  hex "MMIO address of the audio controller"
  default 0xa1000200
endif # HAS_AUDIO

menuconfig HAS_DISK
  depends on !SHARE
  bool "Enable disk"
  default y

if HAS_DISK
config DISK_CTL_PORT
  depends on HAS_PORT_IO
  hex "Port address of the disk controller"
  default 0x300

config DISK_CTL_MMIO
  hex "MMIO address of the disk controller"
  default 0xa1000300

config DISK_IMG_PATH
  string "The path of disk image"
  default ""
endif # HAS_DISK

menuconfig HAS_SDCARD
  depends on !SHARE
  bool "Enable sdcard"
  default y

if HAS_SDCARD
config SDCARD_CTL_MMIO
  hex "MMIO address of the sdcard controller"
  default 0xa3000000

config SDCARD_IMG_PATH
  string "The path of sdcard image"
  default ""
endif # HAS_SDCARD

menuconfig HAS_FLASH
  bool "Enable flash"
  default n

if HAS_FLASH
config FLASH_PRESET_CONTENT
  string "The content of flash preset"
  default "0x0010029b,0x01f29293,0x00028067"

config FLASH_START_ADDR
  hex "Flash start addr"
  default 0x10000000

config FLASH_SIZE
  hex "Flash size"
  default 0x00000100

config FLASH_IMG_PATH
  string "The path of flash image"
  default ""
endif # HAS_FLASH

endif # DEVICE
```
