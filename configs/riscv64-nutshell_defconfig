## configs/riscv64-xs-cfi_defconfig
```kconfig
# layer: riscv64/xs/base.config
# layer: riscv64/xs/kmh/v3/base.config
# layer: riscv64/xs/dut.config

# CONFIG_RV_ZABHA is not set
CONFIG_RV_CFI=y
```

## configs/riscv64-xs-clang-ref_defconfig
```kconfig
# layer: riscv64/xs/base.config
# layer: riscv64/xs/kmh/v3/isa.config
# layer: riscv64/xs/ref.config
# layer: riscv64/xs/kmh/v3/ref.config
# layer: fragments/toolchain/clang.config

# CONFIG_CC_LTO is not set
# CONFIG_CC_O3 is not set
# CONFIG_CUSTOM_XVEXP2 is not set
# CONFIG_CUSTOM_XVEXP2_BF16 is not set
# CONFIG_RV_PMA_ENTRY_32 is not set
CONFIG_RV_PMP_ACTIVE_NUM=16
# CONFIG_RV_PMP_ENTRY_64 is not set
```

## configs/riscv64-xs-clang_defconfig
```kconfig
# layer: riscv64/xs/sim.config
# layer: fragments/toolchain/clang.config

# CONFIG_CC_O3 is not set
CONFIG_CC_OPT_FLAGS="-Wno-error=invalid-feature-combination"
# CONFIG_HAS_FLASH is not set
# CONFIG_MDT_INIT is not set
CONFIG_NMIE_INIT=y
# CONFIG_RESET_FROM_MMIO is not set
# CONFIG_RV_PMA_ENTRY_32 is not set
CONFIG_RV_PMP_ACTIVE_NUM=16
# CONFIG_RV_PMP_ENTRY_64 is not set
```

## configs/riscv64-xs-cpt-with-flash_defconfig
```kconfig
# layer: riscv64/xs/cpt.config
# layer: fragments/checkpoint/cpt.config
# layer: fragments/checkpoint/flash.config

CONFIG_FLASH_SIZE=0x10000000
CONFIG_MSIZE=0x200000000
# CONFIG_NMIE_INIT is not set
# CONFIG_RV_ZAWRS is not set
```

## configs/riscv64-xs-cpt-with-libcheckpoint_defconfig
```kconfig
# layer: riscv64/xs/cpt.config
# layer: fragments/checkpoint/cpt.config

CONFIG_LIBCHECKPOINT_RESTORER=y
CONFIG_MSIZE=0x200000000
```

## configs/riscv64-xs-custom-tensor_defconfig
```kconfig
# layer: riscv64/xs/base.config
# layer: riscv64/xs/kmh/v3/base.config
# layer: riscv64/xs/dut.config
# layer: fragments/ext/custom-tensor.config

# CONFIG_CC_O3 is not set
# CONFIG_HAS_FLASH is not set
# CONFIG_MDT_INIT is not set
CONFIG_NMIE_INIT=y
# CONFIG_RESET_FROM_MMIO is not set
```

## configs/riscv64-xs-diff-spike-withflash_defconfig
```kconfig
# layer: riscv64/xs/base.config
# layer: riscv64/xs/kmh/v3/base.config
# layer: riscv64/xs/dut.config
# layer: fragments/difftest/spike.config
# layer: fragments/checkpoint/flash.config

# CONFIG_AMO_AC_SOFT is not set
# CONFIG_CC_NATIVE_ARCH is not set
# CONFIG_CC_O3 is not set
CONFIG_FLASH_IMG_PATH="$(NEMU_HOME)/resource/gcpt_restore/build/gcpt.bin"
CONFIG_FLASH_SIZE=0x10000000
# CONFIG_MMIO_AC_SOFT is not set
CONFIG_MSIZE=0x200000000
# CONFIG_RVV_AGNOSTIC is not set
# CONFIG_RV_PMA_ENTRY_32 is not set
CONFIG_RV_PMP_ACTIVE_NUM=16
# CONFIG_RV_PMP_ENTRY_64 is not set
# CONFIG_RV_SHLCOFIDELEG is not set
# CONFIG_RV_SMCSRIND is not set
# CONFIG_RV_SMCSRIND_EXTRA_REGS is not set
# CONFIG_RV_SMSTATEEN is not set
# CONFIG_RV_ZAWRS is not set
CONFIG_RV_ZFH=y
CONFIG_ZSTD_COMPRESS=y
```

## configs/riscv64-xs-diff-spike_defconfig
```kconfig
# layer: riscv64/xs/base.config
# layer: riscv64/xs/kmh/v3/base.config
# layer: riscv64/xs/dut.config
# layer: fragments/difftest/spike.config

# CONFIG_AMO_AC_SOFT is not set
# CONFIG_CC_NATIVE_ARCH is not set
# CONFIG_CC_O3 is not set
# CONFIG_HAS_FLASH is not set
# CONFIG_MDT_INIT is not set
# CONFIG_MMIO_AC_SOFT is not set
CONFIG_MSIZE=0x400000000
CONFIG_NMIE_INIT=y
# CONFIG_RESET_FROM_MMIO is not set
# CONFIG_RVV_AGNOSTIC is not set
# CONFIG_RV_PMA_ENTRY_32 is not set
CONFIG_RV_PMP_ACTIVE_NUM=16
# CONFIG_RV_PMP_ENTRY_64 is not set
# CONFIG_RV_SHLCOFIDELEG is not set
# CONFIG_RV_SMCSRIND is not set
# CONFIG_RV_SMCSRIND_EXTRA_REGS is not set
CONFIG_RV_ZFH=y
CONFIG_ZSTD_COMPRESS=y
```

## configs/riscv64-xs-dual-ref_defconfig
```kconfig
# layer: riscv64/xs/base.config
# layer: riscv64/xs/kmh/v3/isa.config
# layer: riscv64/xs/ref.config
# layer: riscv64/xs/kmh/v3/ref.config
# layer: fragments/difftest/multicore.config

CONFIG_CC_DEBUG=y
# CONFIG_CC_O3 is not set
CONFIG_MSIZE=0x200000000
# CONFIG_STORE_LOG is not set
```

## configs/riscv64-xs-kmhv2-dual-ref-debug_defconfig
```kconfig
# layer: riscv64/xs/base.config
# layer: riscv64/xs/kmh/v2/base.config
# layer: riscv64/xs/ref.config
# layer: riscv64/xs/kmh/v2/ref.config
# layer: fragments/difftest/multicore.config
# layer: fragments/debug/debug.config

CONFIG_CC_DEBUG=y
# CONFIG_CC_O3 is not set
CONFIG_MSIZE=0x200000000
CONFIG_SHARE_OUTPUT_LOG_TO_FILE=y
CONFIG_SIMPLE_LOG=y
# CONFIG_STORE_LOG is not set
CONFIG_TRACE_INST_DASM=y
```

## configs/riscv64-xs-kmhv2-ref-debug_defconfig
```kconfig
# layer: riscv64/xs/base.config
# layer: riscv64/xs/kmh/v2.config
# layer: riscv64/xs/ref.config
# layer: riscv64/xs/kmh/v2-ref.config
# layer: fragments/debug/debug.config

# CONFIG_CC_LTO is not set
# CONFIG_CC_O3 is not set
CONFIG_SHARE_OUTPUT_LOG_TO_FILE=y
CONFIG_SIMPLE_LOG=y
CONFIG_TRACE_INST_DASM=y
```

## configs/riscv64-xs-ref-debug_defconfig
```kconfig
# layer: riscv64/xs/base.config
# layer: riscv64/xs/kmh/v3.config
# layer: riscv64/xs/ref.config
# layer: fragments/debug/debug.config

# CONFIG_CC_LTO is not set
# CONFIG_CC_O3 is not set
# CONFIG_CUSTOM_XVEXP2 is not set
# CONFIG_CUSTOM_XVEXP2_BF16 is not set
CONFIG_SHARE_OUTPUT_LOG_TO_FILE=y
CONFIG_SIMPLE_LOG=y
CONFIG_TRACE_INST_DASM=y
```
