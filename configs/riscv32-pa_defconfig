## configs/riscv32-pa_defconfig
```kconfig
# layer: riscv32/base.config

CONFIG_CC_CLANG=y
CONFIG_CC_DEBUG=y
CONFIG_CC_O3=y
CONFIG_PC_RESET_OFFSET=0x100000
```

## configs/riscv64-gem5-ci-h-ref_defconfig
```kconfig
# layer: riscv64/gem5/base.config
# layer: riscv64/gem5/ref.config
# layer: riscv64/gem5/ci-h.config

# CONFIG_RVV_AGNOSTIC is not set
```

## configs/riscv64-matrix-xs-cpt_defconfig
```kconfig
# layer: riscv64/xs/sim.config
# layer: fragments/ext/ame-matrix.config

CONFIG_AME_MLDST_VECTORIZE=y
CONFIG_AME_MMACC_VECTORIZE=y
# CONFIG_CC_O3 is not set
# CONFIG_HAS_FLASH is not set
# CONFIG_MDT_INIT is not set
CONFIG_NMIE_INIT=y
# CONFIG_RESET_FROM_MMIO is not set
# CONFIG_RV_SMCNTRPMF is not set
# CONFIG_RV_ZABHA is not set
```

## configs/riscv64-matrix-xs-dual-ref_defconfig
```kconfig
# layer: riscv64/xs/base.config
# layer: riscv64/xs/kmh/v3/isa.config
# layer: riscv64/xs/ref.config
# layer: fragments/ext/ame-matrix.config
# layer: fragments/difftest/multicore.config

CONFIG_CC_DEBUG=y
# CONFIG_CC_O3 is not set
CONFIG_DIFFTEST_AMU_CTRL=y
CONFIG_MSIZE=0x200000000
# CONFIG_RV_SMCNTRPMF is not set
# CONFIG_RV_SMCDELEG is not set
# CONFIG_RV_ZABHA is not set
# CONFIG_STORE_LOG is not set
```

## configs/riscv64-matrix-xs-golden_defconfig
```kconfig
#
# Direct CUTE golden-model shared library
#
CONFIG_ISA_riscv64=y
CONFIG_RVMATRIX=y
CONFIG_RVMATRIX_TLEN=131072
CONFIG_RVMATRIX_TRLEN=1024
CONFIG_RVMATRIX_MLEN=32
CONFIG_RVMATRIX_MSYNC_32=y
CONFIG_ENGINE_INTERPRETER=y
CONFIG_MODE_SYSTEM=y
CONFIG_CC_GCC=y
CONFIG_CC_O2=y
CONFIG_PADDRBITS=48
CONFIG_FPU_SOFT=y
CONFIG_AC_NONE=y
CONFIG_SHARE=y
CONFIG_SHARE_GOLDEN=y
CONFIG_DETERMINISTIC=y
CONFIG_DISABLE_HOST_ALARM=y
CONFIG_RT_CHECK=y
```

## configs/riscv64-matrix-xs-lite-ref-novecfp_defconfig
```kconfig
# layer: riscv64/xs/base.config
# layer: riscv64/xs/kmh/v3/base.config
# layer: riscv64/xs/ref.config
# layer: riscv64/xs/kmh/v3/ref.config
# layer: fragments/ext/ame-matrix.config

CONFIG_DIFFTEST_AMU_CTRL=y
CONFIG_PERF_OPT_SHARE=y
CONFIG_RV_AME_TLEN=32768
CONFIG_RV_AME_MSYNC_32=y
# CONFIG_RV_SMCNTRPMF is not set
# CONFIG_RV_SMCDELEG is not set
# CONFIG_RV_ZABHA is not set

# Match DiffTest --difftest-exclude Vec,Fp while retaining RVV and FP execution.
# CONFIG_DIFFTEST_CHECK_VRF is not set
# CONFIG_DIFFTEST_CHECK_VCSR is not set
# CONFIG_DIFFTEST_CHECK_FRF is not set
# CONFIG_DIFFTEST_CHECK_FCSR is not set
```

## configs/riscv64-matrix-xs-lite-ref_defconfig
```kconfig
# layer: riscv64/xs/base.config
# layer: riscv64/xs/kmh/v3.config
# layer: riscv64/xs/ref.config
# layer: fragments/ext/ame-matrix.config

CONFIG_DIFFTEST_AMU_CTRL=y
CONFIG_RV_AME_TLEN=32768
# CONFIG_RV_SMCNTRPMF is not set
# CONFIG_RV_SMCDELEG is not set
# CONFIG_RV_ZABHA is not set
```

## configs/riscv64-matrix-xs-lite_defconfig
```kconfig
# layer: riscv64/xs/base.config
# layer: riscv64/xs/kmh/v3/base.config
# layer: riscv64/xs/dut.config
# layer: fragments/ext/ame-matrix.config

CONFIG_AME_MLDST_VECTORIZE=y
CONFIG_AME_MMACC_VECTORIZE=y
CONFIG_RV_AME_TLEN=32768
# CONFIG_RV_SMCNTRPMF is not set
# CONFIG_RV_ZABHA is not set
```

## configs/riscv64-matrix-xs_defconfig
```kconfig
# layer: riscv64/xs/sim.config
# layer: fragments/ext/ame-matrix.config

CONFIG_AME_MLDST_VECTORIZE=y
CONFIG_AME_MMACC_VECTORIZE=y
# CONFIG_RV_SMCNTRPMF is not set
# CONFIG_RV_ZABHA is not set
```

## configs/riscv64-nanhu-dual-ref_defconfig
```kconfig
# layer: riscv64/nanhu.config
# layer: fragments/difftest/ref-share.config
# layer: fragments/difftest/multicore.config

CONFIG_GUIDED_TVAL=y
# CONFIG_HAS_PLIC is not set
# CONFIG_HAS_UARTLITE is not set
# CONFIG_UARTLITE_ASSERT_FOUR is not set
```

## configs/riscv64-nanhu-ref_defconfig
```kconfig
# layer: riscv64/nanhu.config
# layer: fragments/difftest/ref-share.config

CONFIG_GUIDED_TVAL=y
# CONFIG_HAS_PLIC is not set
# CONFIG_HAS_UARTLITE is not set
# CONFIG_UARTLITE_ASSERT_FOUR is not set
```

## configs/riscv64-nutshell-diff-spike_defconfig
```kconfig
# layer: riscv64/nutshell.config
# layer: fragments/difftest/spike.config

# CONFIG_RESET_FROM_MMIO is not set
CONFIG_RV_CSR_MCOUNTINHIBIT=y
CONFIG_RV_CSR_MSECCFG=y
# CONFIG_RV_MSTATUS_FS_WRITABLE is not set
CONFIG_RV_ZICNTR=y
CONFIG_RV_ZIHPM=y
```

## configs/riscv64-nutshell-ref_defconfig
```kconfig
# layer: riscv64/nutshell.config
# layer: fragments/difftest/ref-share.config

# CONFIG_DIFFTEST_STORE_COMMIT is not set
# CONFIG_GUIDED_EXEC is not set
# CONFIG_HAS_FLASH is not set
# CONFIG_HAS_UARTLITE is not set
```
