## configs/riscv64-xs-diff-spike-withflash_defconfig
```kconfig
# layer: riscv64/xs/base.config
# layer: riscv64/xs/kmh/v3/base.config
# layer: riscv64/xs/dut.config
# layer: fragments/difftest/spike.config
# layer: fragments/checkpoint/flash.config

# CONFIG_AMO_AC_SOFT is not set
# CONFIG_CC_NATIVE_ARCH is not set
# CONFIG_CC_O3 is not set
CONFIG_FLASH_SIZE=0x10000000
# CONFIG_MMIO_AC_SOFT is not set
CONFIG_MSIZE=0x200000000
# CONFIG_RVV_AGNOSTIC is not set
# CONFIG_RV_PMA_ENTRY_32 is not set
# CONFIG_RV_SHLCOFIDELEG is not set
CONFIG_RV_ZFH=y
CONFIG_ZSTD_COMPRESS=y
# CONFIG_RV_SSTATUS_MS is not set
CONFIG_RV_AIA=y
CONFIG_RV_IMSIC=y
CONFIG_GEILEN=0
```
