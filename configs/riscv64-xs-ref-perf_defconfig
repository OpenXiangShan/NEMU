## configs/riscv64-xs-ref-perf_defconfig
```kconfig
# layer: riscv64/xs/ref.config

CONFIG_CLINT_LOCAL_TIMER_INTERRUPT=y
CONFIG_HAS_PLIC=y
CONFIG_HAS_UART16550=y
CONFIG_HAS_UARTLITE=y
# CONFIG_RV_AIA is not set
# CONFIG_RV_IMSIC is not set
CONFIG_UARTLITE_ASSERT_FOUR=y
CONFIG_UARTLITE_MMIO=0x40600000
```

## configs/riscv64-xs-ref_bitmap_defconfig
```kconfig
# layer: riscv64/xs/base.config
# layer: riscv64/xs/kmh/v3.config
# layer: riscv64/xs/ref.config
# layer: fragments/ext/bitmap.config

# CONFIG_CC_LTO is not set
# CONFIG_CC_O3 is not set
# CONFIG_CUSTOM_XVEXP2 is not set
# CONFIG_CUSTOM_XVEXP2_BF16 is not set
# CONFIG_RV_PMA_ENTRY_32 is not set
# CONFIG_RV_ZAWRS is not set
```

## configs/riscv64-xs-ref_mpt_defconfig
```kconfig
# layer: riscv64/xs/base.config
# layer: riscv64/xs/kmh/v3/isa.config
# layer: riscv64/xs/ref.config
# layer: fragments/ext/mpt.config

# CONFIG_CC_LTO is not set
# CONFIG_CC_O3 is not set
# CONFIG_CUSTOM_XVEXP2 is not set
# CONFIG_CUSTOM_XVEXP2_BF16 is not set
CONFIG_FLASH_PRESET_CONTENT="0x0010029b,0x01f29293,0x00028067"
# CONFIG_MDT_INIT is not set
CONFIG_NMIE_INIT=y
# CONFIG_RV_ZABHA is not set
```

## configs/riscv64-xs-southlake-debug_defconfig
```kconfig
# layer: riscv64/southlake/base.config
# layer: riscv64/southlake/dut.config
# layer: fragments/debug/debug.config

CONFIG_INSTR_CNT_BY_INSTR_PERF_OPT=y
```

## configs/riscv64-xs-southlake-ref-debug_defconfig
```kconfig
# layer: riscv64/southlake/base.config
# layer: riscv64/southlake/ref.config
# layer: fragments/debug/debug.config

# CONFIG_RV_SDEXT is not set
# CONFIG_RV_SDTRIG is not set
# CONFIG_TDATA1_MCONTROL6 is not set
# CONFIG_USE_XS_ARCH_CSRS is not set
```

## configs/riscv64-xs-zicfilp_defconfig
```kconfig
# layer: riscv64/xs/base.config
# layer: riscv64/xs/kmh/v3.config
# layer: riscv64/xs/sim.config

# CONFIG_RV_ZABHA is not set
CONFIG_RV_ZICFILP=y
```

## configs/riscv64-xs_bitmap_defconfig
```kconfig
# layer: riscv64/xs/base.config
# layer: riscv64/xs/kmh/v3.config
# layer: riscv64/xs/sim.config
# layer: fragments/ext/bitmap.config

# CONFIG_CC_O3 is not set
# CONFIG_HAS_FLASH is not set
# CONFIG_MDT_INIT is not set
CONFIG_NMIE_INIT=y
# CONFIG_RESET_FROM_MMIO is not set
# CONFIG_RV_SMCSRIND is not set
# CONFIG_RV_SMCSRIND_EXTRA_REGS is not set
# CONFIG_RV_ZAWRS is not set
```

## configs/riscv64-xs_mpt_defconfig
```kconfig
# layer: riscv64/xs/base.config
# layer: riscv64/xs/kmh/v3/isa.config
# layer: riscv64/xs/dut.config
# layer: fragments/ext/mpt.config

# CONFIG_CC_O3 is not set
# CONFIG_HAS_FLASH is not set
# CONFIG_MDT_INIT is not set
CONFIG_NMIE_INIT=y
# CONFIG_RESET_FROM_MMIO is not set
# CONFIG_RV_ZABHA is not set
```

## configs/riscv64-yanqihu-ref_defconfig
```kconfig
# layer: riscv64/yanqihu.config
# layer: fragments/difftest/ref-share.config

CONFIG_FLASH_SIZE=0x100000
CONFIG_GUIDED_TVAL=y
# CONFIG_HAS_PLIC is not set
# CONFIG_HAS_UARTLITE is not set
# CONFIG_UARTLITE_ASSERT_FOUR is not set
CONFIG_MSIZE=0x200000000
# CONFIG_RV_PMP_CHECK is not set
```
